## components/audio_decoder/Kconfig
```kconfig
menu "Audio Decoder Configuration"

    config AUDIO_DECODER_WAV_ENABLED
        bool "Enable WAV decoder"
        default y

    config AUDIO_DECODER_MP3_ENABLED
        bool "Enable MP3 decoder (stub)"
        default y
        help
            Currently implemented as a placeholder. A full MP3 decoder
            (e.g. minimp3 or Helix) will be integrated later.

endmenu
```

## components/hub75e_driver/Kconfig
```kconfig
menu "HUB75E Display Driver"

    config HUB75E_WIDTH
        int "Panel width (pixels)"
        default 64

    config HUB75E_HEIGHT
        int "Panel height (pixels)"
        default 64

    # Data pins use the lower GPIO range, away from USB (19/20) and
    # serial JTAG (43/44) pins.
    config HUB75E_PIN_R1
        int "R1 data GPIO"
        range 0 48
        default 35

    config HUB75E_PIN_G1
        int "G1 data GPIO"
        range 0 48
        default 36

    config HUB75E_PIN_B1
        int "B1 data GPIO"
        range 0 48
        default 37

    config HUB75E_PIN_R2
        int "R2 data GPIO"
        range 0 48
        default 14

    config HUB75E_PIN_G2
        int "G2 data GPIO"
        range 0 48
        default 12

    config HUB75E_PIN_B2
        int "B2 data GPIO"
        range 0 48
        default 13

    config HUB75E_PIN_A
        int "Address A GPIO"
        range 0 48
        default 8

    config HUB75E_PIN_B
        int "Address B GPIO"
        range 0 48
        default 18

    config HUB75E_PIN_C
        int "Address C GPIO"
        range 0 48
        default 5

    config HUB75E_PIN_D
        int "Address D GPIO"
        range 0 48
        default 17

    config HUB75E_PIN_E
        int "Address E GPIO"
        range 0 48
        default 21

    config HUB75E_PIN_LAT
        int "Latch GPIO"
        range 0 48
        default 4

    config HUB75E_PIN_OE
        int "Output enable GPIO"
        range 0 48
        default 15

    config HUB75E_PIN_CLK
        int "Clock GPIO"
        range 0 48
        default 16

    config HUB75E_OE_ACTIVE_LOW
        bool "OE active low (most panels)"
        default y
        help
            Most HUB75E panels enable output when OE is LOW.
            Disable this if your panel enables on HIGH.

    config HUB75E_LAT_ACTIVE_HIGH
        bool "Latch active high"
        default y
        help
            Latch data on a HIGH pulse. Disable for LOW pulse.

    config HUB75E_CLK_ACTIVE_HIGH
        bool "Clock active high"
        default y
        help
            Shift data on a HIGH clock pulse. Disable for LOW pulse.

    config HUB75E_CLOCK_DELAY_US
        int "Clock delay (us)"
        range 0 50
        default 0
        help
            Add a delay between clock edges. Increase if the panel
            misses pixels due to fast GPIO transitions.

endmenu
```

## components/spectrum_analyzer/Kconfig
```kconfig
menu "Spectrum Analyzer Configuration"

    config SPECTRUM_NUM_BINS
        int "Number of spectrum bins"
        range 8 64
        default 16

    config SPECTRUM_SMOOTHING
        int "Spectrum smoothing factor (0-99)"
        range 0 99
        default 70

endmenu
```

## components/ui_animations/Kconfig
```kconfig
menu "UI Animations Configuration"

    config UI_ANIMATION_DEFAULT_COLOR
        hex "Default UI color (RGB565)"
        default 0xF800

endmenu
```

## main/Kconfig.projbuild
```kconfig
menu "Pixel Music Companion Configuration"

    config PMC_AUDIO_SAMPLE_RATE
        int "Audio sample rate (Hz)"
        range 8000 96000
        default 44100

    config PMC_DISPLAY_FPS
        int "Display refresh rate (fps)"
        range 10 60
        default 30

    config PMC_BUTTON_DEBOUNCE_MS
        int "Button debounce time (ms)"
        range 10 200
        default 50

    config PMC_BUTTON_LONG_PRESS_MS
        int "Button long press threshold (ms)"
        range 500 3000
        default 1000

    config PMC_BUTTON_SLEEP_PRESS_MS
        int "Sleep button hold threshold (ms)"
        range 1000 5000
        default 3000

    menu "GPIO Pins"

        config PMC_BUTTON_LEFT_GPIO
            int "Left button GPIO"
            range 0 48
            default 0

        config PMC_BUTTON_RIGHT_GPIO
            int "Right button GPIO"
            range 0 48
            default 1

        config PMC_BUTTON_OK_GPIO
            int "OK button GPIO"
            range 0 48
            default 2

        config PMC_I2S_BCLK_GPIO
            int "I2S BCLK GPIO"
            range 0 48
            default 6

        config PMC_I2S_WS_GPIO
            int "I2S WS/LRC GPIO"
            range 0 48
            default 7

        config PMC_I2S_DOUT_GPIO
            int "I2S DOUT GPIO"
            range 0 48
            default 38

        config PMC_I2S_DIN_GPIO
            int "I2S DIN GPIO (microphone)"
            range 0 48
            default 3

        config PMC_MIC_BCLK_GPIO
            int "Microphone I2S BCLK GPIO"
            range 0 48
            default 33

        config PMC_MIC_WS_GPIO
            int "Microphone I2S WS/LRC GPIO"
            range 0 48
            default 34

        config PMC_SD_MOSI_GPIO
            int "SD card MOSI GPIO"
            range 0 48
            default 40

        config PMC_SD_MISO_GPIO
            int "SD card MISO GPIO"
            range 0 48
            default 41

        config PMC_SD_SCLK_GPIO
            int "SD card SCLK GPIO"
            range 0 48
            default 42

        config PMC_SD_CS_GPIO
            int "SD card CS GPIO"
            range 0 48
            default 45

    endmenu

endmenu
```
